## base_external/package/aesddevice/Config.in
```kconfig
config BR2_PACKAGE_AESDDEVICE
	bool "aesddevice"
	help
	  Includes the Linux Device Drivers for Assignment 8
```

## base_external/package/ldd/Config.in
```kconfig
config BR2_PACKAGE_LDD
	bool "ldd"
	help
	  Includes the Linux Device Drivers for Assignment 7
```
